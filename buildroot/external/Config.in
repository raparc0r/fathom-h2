## buildroot/external/package/fathom-player/Config.in
```kconfig
config BR2_PACKAGE_FATHOM_PLAYER
	bool "fathom-player"
	depends on BR2_TOOLCHAIN_HAS_THREADS
	depends on !BR2_SHARED_LIBS  # links statically: needs static libraries
	select BR2_PACKAGE_SQLITE
	select BR2_PACKAGE_FLAC
	select BR2_PACKAGE_MPG123
	select BR2_PACKAGE_JPEG
	select BR2_PACKAGE_FFMPEG
	select BR2_PACKAGE_OPUS
	select BR2_PACKAGE_TREMOR  # Ogg Vorbis, in integers
	help
	  The Fathom music player for the HiFi Walker H2: one static
	  binary, installed to the SD card image (images/sd/fathom/bin)
	  rather than the root filesystem, with its fonts and themes.
```

## buildroot/external/package/fathom-system/Config.in
```kconfig
config BR2_PACKAGE_FATHOM_SYSTEM
	bool "fathom-system"
	help
	  Fathom's small system helpers, built from the repository's
	  device/ folder: fathom-usbrole (the USB-C port's role, in the
	  root filesystem) and fathom-nocache.so (keeps the network
	  drive's and SFTP's reads out of the page cache; on the card).
```

## buildroot/external/package/libfreeaptx/Config.in
```kconfig
config BR2_PACKAGE_LIBFREEAPTX
	bool "libfreeaptx"
	depends on !BR2_STATIC_LIBS  # builds a shared library
	help
	  An aptX encoder and decoder (LGPL-2.1-or-later), forked from
	  libopenaptx 0.2.0 before that project added terms of its own
	  to its licence. Fathom's bluez-alsa uses it for aptX
	  (external.mk).

	  https://github.com/iamthehorker/libfreeaptx
```
